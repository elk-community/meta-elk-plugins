## conf/layer.conf
```bitbake
BBPATH .= ":${LAYERDIR}"

BBFILES += "\
    ${LAYERDIR}/recipes-*/*/*.bb \
    ${LAYERDIR}/recipes-*/*/*.bbappend \
"

BBFILE_COLLECTIONS += "elkplugins"
BBFILE_PATTERN_elkplugins = "^${LAYERDIR}/"
BBFILE_PRIORITY_elkplugins = "9"
LAYERDEPENDS_elkplugins = "core"
LAYERSERIES_COMPAT_elkplugins = "scarthgap"
```
